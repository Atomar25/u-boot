## arch/arm/mach-owl/Kconfig
```kconfig
if ARCH_OWL

choice
        prompt "Actions Semi Owl SoC Variant"
        optional

config MACH_S900
        bool "Actions Semi S900 SoC"
        select ARM64

config MACH_S700
        bool "Actions Semi S700 SoC"
        select ARM64

endchoice

config SYS_TEXT_BASE
        default 0x11000000

config SYS_CONFIG_NAME
        default "s900" if MACH_S900
        default "s700" if MACH_S700

config SYS_SOC
        default "s900" if MACH_S900
        default "s700" if MACH_S700

config DISTRO_DEFAULTS
	default y

config NR_DRAM_BANKS
	default 1

config SYS_RELOC_GD_ENV_ADDR
	default y

config SYS_PROMPT
	default "U-Boot => "

config DISPLAY_BOARDINFO
	default n

endif
```
